## build/conf/bblayers.conf
```bitbake
# POKY_BBLAYERS_CONF_VERSION is increased each time build/conf/bblayers.conf
# changes incompatibly
POKY_BBLAYERS_CONF_VERSION = "2"

BBPATH = "${TOPDIR}"
BBFILES ?= ""

BSPDIR := "${@os.path.abspath(os.path.dirname(d.getVar('FILE', True)) + '/../..')}"

# Core Layers
BBLAYERS += "${BSPDIR}/poky/meta"
BBLAYERS += "${BSPDIR}/poky/meta-poky"
BBLAYERS += "${BSPDIR}/poky/meta-yocto-bsp"

# Third-party layers
BBLAYERS += "${BSPDIR}/layers/meta-raspberrypi"
BBLAYERS += "${BSPDIR}/layers/meta-openembedded/meta-oe"
BBLAYERS += "${BSPDIR}/layers/meta-openembedded/meta-python"
BBLAYERS += "${BSPDIR}/layers/meta-openembedded/meta-networking"

# Custom layers
BBLAYERS += "${BSPDIR}/layers/meta-wifi"
```

## layers/meta-ota/conf/layer.conf
```bitbake
# meta-ota layer configuration
# Provides RAUC-based OTA update support for Raspberry Pi 4B

BBPATH .= ":${LAYERDIR}"
BBFILES += "${LAYERDIR}/recipes-*/*/*.bb \
            ${LAYERDIR}/recipes-*/*/*.bbappend"

BBFILE_COLLECTIONS += "meta-ota"
BBFILE_PATTERN_meta-ota = "^${LAYERDIR}/"
BBFILE_PRIORITY_meta-ota = "9"

LAYERDEPENDS_meta-ota = "core rauc"
LAYERSERIES_COMPAT_meta-ota = "scarthgap"
```

## layers/meta-wifi/conf/layer.conf
```bitbake
# We have a conf and classes directory, add to BBPATH
BBPATH .= ":${LAYERDIR}"

# We have recipes-* directories, add to BBFILES
BBFILES += "${LAYERDIR}/recipes-*/*/*.bb \
            ${LAYERDIR}/recipes-*/*/*.bbappend"

BBFILE_COLLECTIONS += "meta-wifi"
BBFILE_PATTERN_meta-wifi = "^${LAYERDIR}/"
BBFILE_PRIORITY_meta-wifi = "8"

LAYERDEPENDS_meta-wifi = "core networking-layer"

LAYERSERIES_COMPAT_meta-wifi = "scarthgap"
```
